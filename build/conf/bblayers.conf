## build/conf/bblayers.conf
```bitbake
# POKY_BBLAYERS_CONF_VERSION is increased each time build/conf/bblayers.conf
# changes incompatibly
POKY_BBLAYERS_CONF_VERSION = "2"

BBPATH = "${TOPDIR}"
BBFILES ?= ""

BBLAYERS ?= " \
  /home/mickey/yocto-3.1.0/poky-dunfell-23.0.0/meta \
  /home/mickey/yocto-3.1.0/poky-dunfell-23.0.0/meta-poky \
  /home/mickey/yocto-3.1.0/poky-dunfell-23.0.0/meta-raspberrypi \
  /home/mickey/yocto-3.1.0/poky-dunfell-23.0.0/meta-yocto-bsp \
  /home/mickey/yocto-3.1.0/poky-dunfell-23.0.0/meta-openembedded/meta-oe \
  /home/mickey/yocto-3.1.0/poky-dunfell-23.0.0/meta-openembedded/meta-multimedia \
  /home/mickey/yocto-3.1.0/poky-dunfell-23.0.0/meta-openembedded/meta-networking \
  /home/mickey/yocto-3.1.0/poky-dunfell-23.0.0/meta-openembedded/meta-python \
  "
```
